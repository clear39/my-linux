## drivers/byd/Kconfig.byd
```kconfig
config BYD
bool "config byd driver"
default y
help
    This selects byd driver

source "drivers/byd/monitor/Kconfig.byd"
```

## drivers/byd/monitor/Kconfig.byd
```kconfig
config BYD_GUARD
bool "config byd guard driver"
default y
help
    This selects byd guard driver
```
